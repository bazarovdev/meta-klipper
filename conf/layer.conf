## conf/layer.conf
```bitbake
# We have a conf and classes directory, add to BBPATH
BBPATH .= ":${LAYERDIR}"

# We have recipes-* directories, add to BBFILES
BBFILES += " \
    ${LAYERDIR}/recipes-*/*/*.bb \
    ${LAYERDIR}/recipes-*/*/*.bbappend \
    ${LAYERDIR}/recipes-*/*/*/*.bb \
    ${LAYERDIR}/recipes-*/*/*/*.bbappend \
"

BBFILE_COLLECTIONS += "meta-klipper"
BBFILE_PATTERN_meta-klipper = "^${LAYERDIR}/"
BBFILE_PRIORITY_meta-klipper = "15"

LAYERDEPENDS_meta-klipper = "core"
LAYERSERIES_COMPAT_meta-klipper = "honister kirkstone"
```
